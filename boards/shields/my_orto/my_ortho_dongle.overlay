/ {
    chosen {
        zmk,kscan = &fake_kscan;
    };

    fake_kscan: kscan_1 {
        compatible = "zmk,mock-matrix";
        status = "okay";
        columns = <0>;
        rows = <0>;
        events = <0>;
    };
};